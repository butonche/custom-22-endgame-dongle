## boards/shields/xiao_dongle/Kconfig.defconfig
```kconfig
if SHIELD_XIAO_DONGLE

config ZMK_USB
    default y

config ZMK_SPLIT
    default y

config ZMK_SPLIT_BLE_ROLE_CENTRAL
    default y

config I2C
    default y

config SSD1306
    default y

config ZMK_INPUT_PROCESSOR_6DOF
    default y

config ZMK_6DOF_RELAY
    default y

endif
```
