/ {
    btns: connector {
        compatible = "efogtech-trackball-0";
        #gpio-cells = <2>;
        gpio-map-mask = <0xffffffff 0xffffffc0>;
        gpio-map-pass-thru = <0 0x3f>;
        gpio-map
            // Top-right then CCW
            = <0 0 &gpio0 26 0>
            , <1 0 &gpio0 27 0>
            , <2 0 &gpio0 1 0>
            , <3 0 &gpio0 21 0>
            , <4 0 &gpio0 8 0>
            , <5 0 &gpio0 7 0>
            , <6 0 &gpio0 5 0>
            , <7 0 &gpio0 4 0>

            // Encoders
            , <8 0 &gpio0 15 0> // left
            , <9 0 &gpio0 11 0> // right

            // Unified wakeup source
            , <10 0 &gpio0 29 0> // left
            ;
    };
};
