## Kconfig
```kconfig
# Stripped efogdev input processors for trackball peripheral

# Stub for zmk-runtime-config (ec11-ish driver compatibility)
config ZMK_RUNTIME_CONFIG
    bool "Runtime config stub (provides ZRC_GET fallback)"
    default n

if ZMK_POINTING

config ZMK_POINTER_2S_MIXER
    bool "Pointer 2-sensor mixer"
    default n
    depends on INPUT

if ZMK_POINTER_2S_MIXER

config POINTER_2S_MIXER_DEFAULT_MOVE_COEF
    int "Default pointer movement coefficient"
    default 20

config POINTER_2S_MIXER_DEFAULT_TWIST_COEF
    int "Default twist scroll coefficient"
    default 5

config POINTER_2S_MIXER_EMA_ALPHA
    int "EMA smoothing alpha (1-50)"
    default 10

config POINTER_2S_MIXER_ENSURE_SYNC
    bool "Ensure sensor sync"
    default y

config POINTER_2S_MIXER_SYNC_WINDOW_MS
    int "Sync window in ms"
    default 2

config POINTER_2S_MIXER_SCROLL_DISABLES_POINTER
    bool "Scroll disables pointer movement"
    default n

config POINTER_2S_MIXER_POINTER_AFTER_SCROLL_ACTIVATION
    int "Pointer reactivation delay after scroll (ms)"
    default 100

config POINTER_2S_MIXER_DELTA_Y_OVER_TRANS_MAG_MUL
    int "Delta Y magnitude multiplier"
    default 4

config POINTER_2S_MIXER_DELTA_Y_OVER_TRANS_MAG_DIV
    int "Delta Y magnitude divisor"
    default 3

config POINTER_2S_MIXER_STEADY_THRES
    int "Steady threshold"
    default 4

config POINTER_2S_MIXER_STEADY_COOLDOWN
    int "Steady cooldown (ms)"
    default 150

config POINTER_2S_MIXER_REMAINDER_TTL
    int "Remainder time-to-live (ms)"
    default 16

config POINTER_2S_MIXER_TWIST_REMAINDER_TTL
    int "Twist remainder TTL (ms)"
    default 100

config POINTER_2S_MIXER_TWIST_FILTER_TTL
    int "Twist filter TTL (ms)"
    default 65

config POINTER_2S_MIXER_TWIST_FILTER_DEBOUNCE
    int "Twist filter debounce (ms)"
    default 35

config POINTER_2S_MIXER_TWIST_MAX_VALUE
    int "Twist max value"
    default 750

config POINTER_2S_MIXER_SIGNIFICANT_MOVEMENT_MUL
    int "Significant movement multiplier"
    default 15

config POINTER_2S_MIXER_DIRECTION_FILTER_EN
    bool "Enable direction filter"
    default y

config POINTER_2S_MIXER_DIRECTION_FILTER_TTL
    int "Direction filter TTL (ms)"
    default 80

config POINTER_2S_MIXER_LAZY_INIT
    bool "Lazy initialization"
    default n

config POINTER_2S_MIXER_SMA_EN
    bool "Enable SMA smoothing"
    default n

config POINTER_2S_MIXER_SMA_WINDOW_SIZE
    int "SMA window size"
    default 3

config POINTER_2S_MIXER_SMA_WINDOW_SIZE_MAX
    int "SMA maximum window size"
    default 12

config POINTER_2S_MIXER_SMA_TIMEOUT
    int "SMA timeout (ms)"
    default 64

config POINTER_2S_MIXER_SETTINGS_SAVE_DELAY
    int "Settings save delay (ms)"
    default 2500

config POINTER_2S_MIXER_34_FILTER_EN
    bool "Enable 3/4 filter"
    default y

config POINTER_2S_MIXER_FEEDBACK_EN
    bool "Enable feedback (not used in stripped version)"
    default n

config POINTER_2S_MIXER_FEEDBACK_MAX_CONTINUOUS
    int "Feedback max continuous (ms)"
    default 65

config POINTER_2S_MIXER_FEEDBACK_COOLDOWN
    int "Feedback cooldown (ms)"
    default 160

endif # ZMK_POINTER_2S_MIXER

config ZMK_ACCEL_CURVE
    bool "Acceleration curves"
    default n
    depends on INPUT

config ZMK_INPUT_PROCESSOR_REPORT_RATE_LIMIT
    bool "Report rate limiter"
    default n

config ZMK_INPUT_PROCESSOR_REPORT_RATE_LIMIT_DEFAULT
    int "Default rate limit in ms"
    default 8

config ZMK_SCROLL_SCALER
    bool "Scroll scaler with internal remainder tracking"
    default n

endif # ZMK_POINTING
```

## boards/arm/efogtech_trackball_0/Kconfig.defconfig
```kconfig
# Efogtech Endgame Trackball board configuration

# Copyright (c) 2020 The ZMK Contributors
# SPDX-License-Identifier: MIT

if BOARD_EFOGTECH_TRBL_52833

config BOARD
    default "efogtech_trackball_0"

config ZMK_KEYBOARD_NAME
    default "Endgame"

config EC11
    default y

config PWM
    default y

config LED_PWM
    default y

config SPI
    default y

config BT_CTLR
    default BT

config ZMK_BLE
	default y

if ZMK_BLE

config ZMK_BLE_EXPERIMENTAL_CONN
    default y

config ZMK_BLE_EXPERIMENTAL_SEC
    default y

config ZMK_BLE_EXPERIMENTAL_FEATURES
    default y

config ZMK_BLE_PASSKEY_ENTRY
    default n

config BT_CTLR_TX_PWR_PLUS_8
    default y

config BT_CTLR_CONN_RSSI
    default y

config BT_CTLR_TX_PWR_DYNAMIC_CONTROL
    default y

config BT_CTLR_PHY_2M
    default y

config BT_PERIPHERAL_PREF_MAX_INT
    default 6

config BT_TPS
    default y

config BT_GATT_ENFORCE_SUBSCRIPTION
    default y

config BT_MAX_CONN
    default 5

config BT_MAX_PAIRED
    default 5

config ZMK_BLE_MOUSE_REPORT_QUEUE_SIZE
    default 1

config ZMK_BLE_THREAD_STACK_SIZE
    default 1360

config ZMK_BLE_THREAD_PRIORITY
    default 2

config BT_L2CAP_TX_MTU
    default 65

config BT_L2CAP_TX_FRAG_COUNT
    default 3

config BT_BUF_ACL_RX_SIZE
    default 69

config BT_BUF_ACL_TX_SIZE
    default 72

endif # ZMK_BLE

endif # BOARD_EFOGTECH_TRBL_52833
```

## boards/arm/efogtech_trackball_0/efogtech_trackball_0_defconfig
```kconfig
# SPDX-License-Identifier: MIT

# Board identification
CONFIG_BOARD_EFOGTECH_0_VER_MAJOR=100
CONFIG_BOARD_EFOGTECH_0_VER_MINOR=4
CONFIG_BOARD_EFOGTECH_0_VER_PATCH=22
CONFIG_BOARD_EFOGTECH_TRBL_52833=y
CONFIG_SOC_SERIES_NRF52X=y
CONFIG_SOC_NRF52833_QIAA=y
CONFIG_ARM_MPU=y
CONFIG_HW_STACK_PROTECTION=n
CONFIG_USE_DT_CODE_PARTITION=y
CONFIG_BUILD_OUTPUT_UF2=y

# Storage
CONFIG_NVS=y
CONFIG_SETTINGS_NVS=y
CONFIG_FLASH=y
CONFIG_FLASH_PAGE_LAYOUT=y
CONFIG_FLASH_MAP=y
CONFIG_CLOCK_CONTROL_NRF=y
CONFIG_CLOCK_CONTROL_NRF_K32SRC_RC=y

# Split peripheral
CONFIG_ZMK_SPLIT=y
CONFIG_ZMK_USB=n

# Pointing
CONFIG_ZMK_POINTING=y
CONFIG_SPI=y
CONFIG_SPI_ASYNC=y
CONFIG_INPUT=y
CONFIG_GPIO=y
CONFIG_PINCTRL=y
CONFIG_NFCT_PINS_AS_GPIOS=y
CONFIG_PAW3395=y
CONFIG_INPUT_THREAD_STACK_SIZE=1024
CONFIG_ZMK_POINTER_2S_MIXER=y
CONFIG_ZMK_ACCEL_CURVE=y
CONFIG_ZMK_SCROLL_SCALER=y
CONFIG_ZMK_INPUT_PROCESSOR_REPORT_RATE_LIMIT=y
CONFIG_ZMK_INPUT_PROCESSOR_REPORT_RATE_LIMIT_DEFAULT=8
CONFIG_ZMK_RUNTIME_CONFIG=y

# Encoders
CONFIG_EC11=y
CONFIG_EC11_ISH=y

# Debounce
CONFIG_ZMK_KSCAN_DEBOUNCE_PRESS_MS=0
CONFIG_ZMK_KSCAN_DEBOUNCE_RELEASE_MS=0

# Power management
CONFIG_PM_DEVICE=y
CONFIG_PM_DEVICE_RUNTIME=y
CONFIG_PM_DEVICE_RUNTIME_EXCLUSIVE=n

# Build optimization
CONFIG_SIZE_OPTIMIZATIONS=n
CONFIG_SPEED_OPTIMIZATIONS=y
CONFIG_BUILD_OUTPUT_STRIPPED=y
CONFIG_DEBUG_INFO=n
CONFIG_ASSERT=n
CONFIG_BOOT_BANNER=n
CONFIG_SPI_NRFX_RAM_BUFFER_SIZE=24

# UART (needed for board init code)
CONFIG_SERIAL=y

# Settings save
CONFIG_ZMK_SETTINGS_SAVE_DEBOUNCE=2500

# Keyboard name
CONFIG_ZMK_KEYBOARD_NAME="Endgame"
```

## boards/shields/custom_22/Kconfig.shield
```kconfig
config SHIELD_CUSTOM_22_LEFT
	def_bool $(shields_list_contains,custom_22_left)

config SHIELD_CUSTOM_22_RIGHT
	def_bool $(shields_list_contains,custom_22_right)
```

## boards/shields/custom_22_left/Kconfig.defconfig
```kconfig
if SHIELD_CUSTOM_22_LEFT

config ZMK_BLE
    default y

config ZMK_SPLIT
    default y

config ZMK_SLEEP
    default y

endif
```

## config/west.yml
```yaml
manifest:
  remotes:
    - name: zmkfirmware
      url-base: https://github.com/zmkfirmware
    - name: butonche
      url-base: https://github.com/butonche
    - name: efogdev
      url-base: https://github.com/efogdev
    - name: englmaxi
      url-base: https://github.com/englmaxi
    - name: badjeff
      url-base: https://github.com/badjeff
  projects:
    - name: zmk
      remote: zmkfirmware
      revision: v0.3
      import: app/west.yml
    - name: zmk-paw3395-driver
      remote: efogdev
      revision: 209a1f9
    - name: zmk-ec11-ish-driver
      remote: efogdev
      revision: a539bed
    - name: zmk-feature-rolling-combos
      remote: butonche
      revision: main
    - name: zmk-dongle-display
      remote: englmaxi
      revision: v0.3
    - name: zmk-input-processor-xyz
      remote: badjeff
      revision: main
  self:
    path: config
```

## dts/bindings/input/zmk,input-mock-sensor.yaml
```yaml
description: |
  Mock input sensor that emits a fixed sequence of REL_X/REL_Y event pairs
  at boot, driven by a k_work_delayable chain. Intended for ZMK native_sim
  tests of dual-sensor input processors.

  Each entry in the 'events' array is a triplet: dx dy delay_ms.
  The delay is applied BEFORE that event fires (i.e. the first event fires
  after the first delay_ms, giving the system time to initialise).

  Example:
    events = <10 (-5) 20   (-10) 5 20   0 0 0>;
    // fires dx=10,dy=-5 at t=20ms, dx=-10,dy=5 at t=40ms, then stops

compatible: "zmk,input-mock-sensor"

properties:
  events:
    type: array
    required: true
    description: |
      Flat array of (dx, dy, delay_ms) triplets.
      delay_ms is the wait before this event fires.
```

## dts/bindings/input_processors/zmk,accel-curve.yaml
```yaml
description: Acceleration curve input processor with DTS-defined Bezier curves
compatible: "zmk,accel-curve"

include: ip_zero_param.yaml

properties:
  max-curves:
    type: int
    default: 4
  points:
    type: int
    required: true
    description: Number of interpolation points in the lookup table
  device-name:
    type: string
  event-codes:
    type: array
    required: true
    description: Input event codes to process (e.g. INPUT_REL_X, INPUT_REL_Y)
  curve-data:
    type: array
    description: |
      Bezier control points as groups of 8 int16 values per segment:
      start_x, start_y, end_x, end_y, cp1_x, cp1_y, cp2_x, cp2_y.
      Values are scaled by 100 (e.g. 41 means 0.41).
```

## dts/bindings/input_processors/zmk,input-processor-6dof.yaml
```yaml
description: 6DOF input processor — remaps X/Y/Z events to RX/RY/RZ on dongle side

compatible: "zmk,input-processor-6dof"

include: ip_zero_param.yaml
```

## dts/bindings/input_processors/zmk,input-processor-drop-zero.yaml
```yaml
description: Drop zero-value input events

compatible: "zmk,input-processor-drop-zero"

include: ip_zero_param.yaml
```

## dts/bindings/input_processors/zmk,input-processor-report-rate-limit.yaml
```yaml
description: Input Processor for limiting the rate of input reports
compatible: "zmk,input-processor-report-rate-limit"

include: ip_zero_param.yaml

properties:
  type:
    type: int
  codes:
    type: array
    required: true
  limit-ble-only:
    type: boolean
```

## dts/bindings/input_processors/zmk,pointer-2s-mixer.yaml
```yaml
description: Input Processor for mixing readings from two mouse sensors (stripped)
compatible: "zmk,pointer-2s-mixer"

include: ip_common.yaml

properties:
  "#input-processor-cells":
    type: int
    required: true
    const: 1
  sync-report-ms:
    type: int
    required: true
    default: 2
  sync-scroll-report-ms:
    type: int
    required: true
    default: 8
  twist-interference-thres:
    type: int
    required: true
    default: 200
  twist-thres:
    type: int
    required: true
    default: 4
  sensor1-pos:
    type: uint8-array
    required: true
    default: [ 0, 128, 0 ]
  sensor2-pos:
    type: uint8-array
    required: true
    default: [ 255, 128, 0 ]
  ball-radius:
    type: int
    required: true
    default: 120

input-processor-cells:
  - param1
```

## dts/bindings/input_processors/zmk,scroll-scaler.yaml
```yaml
description: Scroll scaler with internal remainder tracking for input-split

compatible: "zmk,scroll-scaler"

include: ip_two_param.yaml
```
